## nrf copy/build/hum_sensor/Kconfig/Kconfig.shield
```kconfig
osource "/opt/nordic/ncs/blinky_2/boards/shields/*/Kconfig.shield"
osource "/opt/nordic/ncs/v2.9.2/nrf/boards/shields/*/Kconfig.shield"
```

## nrf/build/Kconfig/Kconfig.shield.defconfig
```kconfig
osource "/opt/nordic/ncs/blinky_2/boards/shields/*/Kconfig.defconfig"
osource "/opt/nordic/ncs/v2.9.2/nrf/boards/shields/*/Kconfig.defconfig"
```
